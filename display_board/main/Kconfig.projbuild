## display_board/main/Kconfig.projbuild
```kconfig
menu "ELM327 BLE Dashboard"
    config OBD2_TRANSPORT_ELM327_BLE
        bool
        default y

    config OBD2_ELM327_BLE_NAME
        string
        default ""
        help
            Legacy configuration, no longer used. Select a device from the
            Bluetooth settings scan list instead.

    config OBD2_ELM327_BLE_ADDRESS
        string
        default ""
        help
            Legacy configuration, no longer used. A successfully initialized
            adapter is remembered in NVS for one automatic reconnect attempt.

    config OBD2_ELM327_SERVICE_UUID
        string "Custom UART service UUID (optional)"
        default ""
    config OBD2_ELM327_WRITE_UUID
        string "Custom writable characteristic UUID (optional)"
        default ""
    config OBD2_ELM327_NOTIFY_UUID
        string "Custom notify/indicate characteristic UUID (optional)"
        default ""
        help
            Set all three UUIDs together, or leave all empty for FFF0/FFF2/FFF1,
            FFE0/FFE1/FFE1 and Nordic UART Service. UUIDs can be 16 or 128 bits.

    config OBD2_ELM327_BLE_REQUIRE_PAIRING
        bool "Pair before discovery (for encrypted UART adapters)"
        default n
    config OBD2_ELM327_BLE_PASSKEY
        int "BLE passkey (-1: Just Works/no input)"
        range -1 999999
        default -1
        help
            This is a BLE SMP passkey, not a Classic Bluetooth serial PIN.
            A configured passkey enables pairing before service discovery.

    config OBD2_POLL_INTERVAL_MS
        int "Minimum delay between PID commands (ms)"
        default 50
        range 20 1000
    config OBD2_RESPONSE_TIMEOUT_MS
        int "ELM response prompt timeout (ms)"
        default 1500
        range 500 5000
    config OBD2_ELM327_SEARCH_TIMEOUT_MS
        int "Initial vehicle protocol search timeout (ms)"
        default 20000
        range 5000 30000
endmenu

menu "Vehicle P4 services"
    config DEVICE_FM_SDA_GPIO
        int "RDA5807M I2C0 SDA GPIO"
        default 2
        range 2 6
        help
            EV Board v1.4: GPIO2 is J1 pin 21. Use external pull-ups to 3.3 V.
            Keep distinct from the GPS RX and FM SCL GPIOs.
    config DEVICE_FM_SCL_GPIO
        int "RDA5807M I2C0 SCL GPIO"
        default 3
        range 2 6
        help
            EV Board v1.4: GPIO3 is J1 pin 19. Board devices use I2C1 at GPIO7/8.
    config DEVICE_GPS_RX_GPIO
        int "GPS UART1 RX GPIO (module TX connects here)"
        default 4
        range 2 6
        help
            EV Board v1.4: GPIO4 is J1 pin 18. Receive-only at 3.3 V logic.
            These pins are unused by the default BSP; check external wiring.
    config DEVICE_GPS_BAUD
        int "GPS UART baud rate (8N1)"
        default 9600
        range 4800 115200
        help
            ATGM336H-5N factory default is 9600. Match the module configuration.
    config DEVICE_WIFI_SSID
        string "Initial phone hotspot SSID (prefer serial provisioning)"
        default ""
    config DEVICE_WIFI_PASSWORD
        string "Initial phone hotspot password"
        default ""
    config DEVICE_RECORD_MAX_FILES
        int "Maximum sealed diagnostic files"
        default 16
        range 2 64
    config DEVICE_RECORD_FILE_KB
        int "Maximum diagnostic segment size (KiB)"
        default 256
        range 32 1024
    config DEVICE_TRUST_DIR
        string "Directory containing service_ca.pem and ota_public.pem (empty: OTA disabled)"
        default ""
        help
            Public trust files only. Never put private signing keys in firmware.
            Run tools/lab_server.py init to create a development trust directory.
    config DEVICE_BENCH_MAINTENANCE
        bool "Allow explicit bench OTA confirmation without valid vehicle speed"
        default n
        help
            Laboratory builds only. Still requires an explicit local confirmation.
    config DEVICE_CAMERA_ENABLED
        bool "Enable camera feature and UI"
        default y
        help
            Include camera preview, photo capture and album controls. Disabled
            builds hide camera UI and do not start the camera service.
    config DEVICE_CAMERA_PREVIEW_FPS
        int "Maximum camera preview updates per second"
        depends on DEVICE_CAMERA_ENABLED
        default 8
        range 1 15
endmenu
```

## display_board/sdkconfig.defaults
```kconfig
CONFIG_IDF_TARGET="esp32p4"
CONFIG_LV_FONT_FMT_TXT_LARGE=y
CONFIG_ESPTOOLPY_FLASHSIZE_16MB=y
CONFIG_ESPTOOLPY_FLASHSIZE="16MB"
CONFIG_PARTITION_TABLE_CUSTOM=y
CONFIG_PARTITION_TABLE_CUSTOM_FILENAME="partitions.csv"
CONFIG_BOOTLOADER_APP_ROLLBACK_ENABLE=y
CONFIG_ESP_DEFAULT_CPU_FREQ_MHZ_360=y
CONFIG_FREERTOS_HZ=1000
CONFIG_ESP_MAIN_TASK_STACK_SIZE=8192
CONFIG_SPIRAM=y
CONFIG_SPIRAM_SPEED_200M=y
CONFIG_SPIRAM_USE_MALLOC=y
CONFIG_ESP32P4_SELECTS_REV_LESS_V3=y
CONFIG_BSP_LCD_TYPE_1024_600=y
CONFIG_BSP_LCD_COLOR_FORMAT_RGB565=y
CONFIG_BSP_ERROR_CHECK=n
CONFIG_BSP_SD_FORMAT_ON_MOUNT_FAIL=n
CONFIG_LV_CONF_SKIP=y
CONFIG_LV_COLOR_DEPTH_16=y
CONFIG_LV_FONT_MONTSERRAT_14=y
CONFIG_LV_FONT_MONTSERRAT_16=y
CONFIG_LV_FONT_MONTSERRAT_18=y
CONFIG_LV_FONT_MONTSERRAT_24=y
CONFIG_LV_FONT_MONTSERRAT_32=y
CONFIG_LV_FONT_MONTSERRAT_48=y
CONFIG_LV_USE_ARC=y
CONFIG_LV_USE_BAR=y
CONFIG_LV_USE_LABEL=y
CONFIG_LV_USE_CANVAS=y
CONFIG_LV_USE_KEYBOARD=y
CONFIG_LV_USE_TEXTAREA=y
CONFIG_LV_USE_SLIDER=y
CONFIG_BT_ENABLED=y
CONFIG_BT_NIMBLE_ENABLED=y
CONFIG_BT_CONTROLLER_DISABLED=y
CONFIG_BT_NIMBLE_TRANSPORT_UART=n
CONFIG_ESP_HOSTED_ENABLE_BT_NIMBLE=y
CONFIG_ESP_HOSTED_NIMBLE_HCI_VHCI=y
CONFIG_ESP_HOSTED_P4_DEV_BOARD_FUNC_BOARD=y
CONFIG_ESP_HOSTED_CP_TARGET_ESP32C6=y
CONFIG_ESP_HOSTED_SDIO_HOST_INTERFACE=y
CONFIG_ESP_HOSTED_CLI_ENABLED=n
CONFIG_ESP_CONSOLE_UART_DEFAULT=y
CONFIG_ESP_CONSOLE_SECONDARY_NONE=y
CONFIG_FATFS_LFN_HEAP=y
CONFIG_FATFS_CODEPAGE_936=y
CONFIG_FATFS_API_ENCODING_UTF_8=y
CONFIG_LWIP_SNTP_MAX_SERVERS=2
# Sustain remote MP3 streams over high-latency mobile links (40 MSS + 2 mailbox slots).
CONFIG_LWIP_TCP_WND_DEFAULT=57600
CONFIG_LWIP_TCP_RECVMBOX_SIZE=42
CONFIG_SPIRAM_TRY_ALLOCATE_WIFI_LWIP=y
# Keep UI objects and text out of the internal RAM needed by task stacks/radio.
CONFIG_LV_USE_CUSTOM_MALLOC=y
CONFIG_XIAOZHI_SYNC_SYSTEM_TIME_FROM_SERVER=n
CONFIG_SR_WN_WN9_NIHAOXIAOZHI_TTS=y
CONFIG_SR_VADN_VADNET1_MEDIUM=y
CONFIG_ESP_HOSTED_MEM_MONITOR=n
CONFIG_ESP_HOSTED_MEMPOOL_PREFER_SPIRAM=y
CONFIG_CAMERA_SC2336=y
# CONFIG_DEVICE_CAMERA_ENABLED is not set
CONFIG_CAMERA_OV5647=y
CONFIG_ESP_VIDEO_ENABLE_DVP_VIDEO_DEVICE=n
CONFIG_BT_NIMBLE_ROLE_PERIPHERAL=n
CONFIG_BT_NIMBLE_ROLE_BROADCASTER=n
CONFIG_BT_NIMBLE_MAX_CONNECTIONS=1
CONFIG_BT_NIMBLE_NVS_PERSIST=y
CONFIG_BT_NIMBLE_ATT_PREFERRED_MTU=185
CONFIG_OBD2_TRANSPORT_ELM327_BLE=y
CONFIG_OBD2_ELM327_BLE_NAME=""
CONFIG_OBD2_POLL_INTERVAL_MS=50
CONFIG_OBD2_RESPONSE_TIMEOUT_MS=1500
CONFIG_MBEDTLS_CERTIFICATE_BUNDLE=y
# Keep TLS records/certificates in PSRAM; hardware crypto DMA stays internal.
CONFIG_MBEDTLS_EXTERNAL_MEM_ALLOC=y
CONFIG_MBEDTLS_CERTIFICATE_BUNDLE_DEFAULT_FULL=y
```

## firmware/obd_ble_node/sdkconfig.defaults
```kconfig
CONFIG_IDF_TARGET="esp32c3"
CONFIG_ESPTOOLPY_FLASHSIZE_4MB=y
CONFIG_ESPTOOLPY_FLASHMODE_DIO=y
CONFIG_ESPTOOLPY_FLASHFREQ_40M=y
CONFIG_PARTITION_TABLE_CUSTOM=y
CONFIG_PARTITION_TABLE_CUSTOM_FILENAME="partitions.csv"
CONFIG_BT_ENABLED=y
CONFIG_BT_NIMBLE_ENABLED=y
CONFIG_BT_NIMBLE_ROLE_CENTRAL=n
CONFIG_BT_NIMBLE_ROLE_OBSERVER=n
CONFIG_BT_NIMBLE_MAX_CONNECTIONS=1
CONFIG_BT_NIMBLE_MAX_BONDS=4
CONFIG_BT_NIMBLE_NVS_PERSIST=y
CONFIG_BT_NIMBLE_ATT_PREFERRED_MTU=247
CONFIG_BT_NIMBLE_MSYS_1_BLOCK_COUNT=32
CONFIG_ESP_CONSOLE_UART_DEFAULT=y
CONFIG_ESP_CONSOLE_SECONDARY_NONE=y
CONFIG_FREERTOS_HZ=1000
CONFIG_COMPILER_OPTIMIZATION_SIZE=y
CONFIG_LOG_DEFAULT_LEVEL_WARN=y
CONFIG_ESP_TASK_WDT_EN=y
CONFIG_ESP_TASK_WDT_INIT=y
CONFIG_ESP_TASK_WDT_PANIC=y
```

## main/Kconfig.projbuild
```kconfig
menu "ELM327 BLE Dashboard"
    config OBD2_TRANSPORT_ELM327_BLE
        bool
        default y

    config OBD2_ELM327_BLE_NAME
        string "Adapter name filter (empty: common adapter names)"
        default ""
        help
            Case-insensitive substring. Empty accepts OBD, ELM, VLINK, V-LINK,
            VEEPEAK and VGATE names. Only BLE adapters are supported, not Classic SPP.

    config OBD2_ELM327_BLE_ADDRESS
        string "Adapter address (optional AA:BB:CC:DD:EE:FF)"
        default ""
        help
            An address overrides the name filter. Use this to select one adapter
            when several are nearby. Private random addresses may rotate.

    config OBD2_ELM327_SERVICE_UUID
        string "Custom UART service UUID (optional)"
        default ""
    config OBD2_ELM327_WRITE_UUID
        string "Custom writable characteristic UUID (optional)"
        default ""
    config OBD2_ELM327_NOTIFY_UUID
        string "Custom notify/indicate characteristic UUID (optional)"
        default ""
        help
            Set all three UUIDs together, or leave all empty for FFF0/FFF2/FFF1,
            FFE0/FFE1/FFE1 and Nordic UART Service. UUIDs can be 16 or 128 bits.

    config OBD2_ELM327_BLE_REQUIRE_PAIRING
        bool "Pair before discovery (for encrypted UART adapters)"
        default n
    config OBD2_ELM327_BLE_PASSKEY
        int "BLE passkey (-1: Just Works/no input)"
        range -1 999999
        default -1
        help
            This is a BLE SMP passkey, not a Classic Bluetooth serial PIN.
            A configured passkey enables pairing before service discovery.

    config OBD2_POLL_INTERVAL_MS
        int "Minimum delay between PID commands (ms)"
        default 50
        range 20 1000
    config OBD2_RESPONSE_TIMEOUT_MS
        int "ELM response prompt timeout (ms)"
        default 1500
        range 500 5000
    config OBD2_ELM327_SEARCH_TIMEOUT_MS
        int "Initial vehicle protocol search timeout (ms)"
        default 20000
        range 5000 30000
endmenu
```

## projects/direct_can/sdkconfig.defaults
```kconfig
CONFIG_OBD2_TRANSPORT_DIRECT_CAN=y
CONFIG_OBD2_CAN_TX_GPIO=20
CONFIG_OBD2_CAN_RX_GPIO=19
CONFIG_OBD2_CAN_BITRATE=500000
CONFIG_OBD2_POLL_INTERVAL_MS=1000
CONFIG_OBD2_RESPONSE_TIMEOUT_MS=120
```

## projects/elm327_ble/sdkconfig.defaults
```kconfig
CONFIG_OBD2_TRANSPORT_ELM327_BLE=y
CONFIG_OBD2_ELM327_BLE_NAME="OBDII"
CONFIG_OBD2_POLL_INTERVAL_MS=1000
CONFIG_OBD2_RESPONSE_TIMEOUT_MS=800
```

## sdkconfig.defaults
```kconfig
CONFIG_ESPTOOLPY_FLASHSIZE_16MB=y
CONFIG_ESPTOOLPY_FLASHSIZE="16MB"
CONFIG_PARTITION_TABLE_SINGLE_APP_LARGE=y
CONFIG_ESP_DEFAULT_CPU_FREQ_MHZ_240=y
CONFIG_ESP_DEFAULT_CPU_FREQ_MHZ=240
CONFIG_SPIRAM=y
CONFIG_SPIRAM_MODE_OCT=y
CONFIG_SPIRAM_SPEED_80M=y
CONFIG_SPIRAM_XIP_FROM_PSRAM=y
CONFIG_LV_CONF_SKIP=y
CONFIG_LV_COLOR_DEPTH_16=y
CONFIG_LV_FONT_MONTSERRAT_14=y
CONFIG_LV_FONT_MONTSERRAT_16=y
CONFIG_LV_FONT_MONTSERRAT_18=y
CONFIG_LV_FONT_MONTSERRAT_24=y
CONFIG_LV_FONT_MONTSERRAT_32=y
CONFIG_LV_FONT_MONTSERRAT_48=y
CONFIG_LV_USE_ARC=y
CONFIG_LV_USE_BAR=y
CONFIG_LV_USE_LABEL=y
CONFIG_BT_ENABLED=y
CONFIG_BT_NIMBLE_ENABLED=y
CONFIG_BT_NIMBLE_ROLE_PERIPHERAL=n
CONFIG_BT_NIMBLE_ROLE_BROADCASTER=n
CONFIG_BT_NIMBLE_MAX_CONNECTIONS=1
CONFIG_BT_NIMBLE_NVS_PERSIST=y
CONFIG_BT_NIMBLE_ATT_PREFERRED_MTU=185
CONFIG_OBD2_TRANSPORT_ELM327_BLE=y
CONFIG_OBD2_ELM327_BLE_NAME=""
CONFIG_OBD2_POLL_INTERVAL_MS=50
CONFIG_OBD2_RESPONSE_TIMEOUT_MS=1500
```
